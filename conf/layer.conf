## conf/layer.conf
```bitbake
# We have a conf and classes directory, add to BBPATH
BBPATH := "${BBPATH}:${LAYERDIR}"

# We have a packages directory, add to BBFILES
BBFILES += "${LAYERDIR}/recipes*/*/*.bb ${LAYERDIR}/recipes*/*/*.bbappend"

BBFILE_COLLECTIONS += "opensprinkler"
BBFILE_PATTERN_opensprinkler := "^${LAYERDIR}/"
BBFILE_PRIORITY_opensprinkler = "38"

LAYERDEPENDS_opensprinkler = "core meta-beagleboard-common"
```
